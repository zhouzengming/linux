/dts-v1/;
/plugin/;

/*
 * FV01 Raspberry Pi 40-Pin Header Hardware SPI12 Overlay (QUP1_SE4 @ 0xa90000)
 * Unlocked under Open-FW EL2 (TF-A QTI_XPU_BYPASS). Mutually exclusive with
 * fv01-rpi-i2c12 and fv01-rpi-uart12 on QUP1_SE4.
 * - Pin 19 (MOSI): TLMM GPIO 49
 * - Pin 21 (MISO): TLMM GPIO 48
 * - Pin 23 (SCLK): TLMM GPIO 50
 * - Pin 24 (CS0):  TLMM GPIO 51
 */

&spi12 {
	#address-cells = <1>;
	#size-cells = <0>;
	status = "okay";

	spidev@0 {
		compatible = "rohm,dh2228fv";
		reg = <0>;
		spi-max-frequency = <10000000>;
	};
};
