/dts-v1/;
/plugin/;

/*
 * FV01 Qualcomm 40-Pin Header I2C14 Overlay (QUP1_SE6 @ 0xa98000)
 * Mutually exclusive with fv01-qcom-spi14 and fv01-qcom-uart14 on QUP1_SE6.
 * - Pin 11 (SDA): TLMM GPIO 56
 * - Pin 13 (SCL): TLMM GPIO 57
 * Pins 15/17 (GPIO 58/59) remain free as GPIO.
 */

&i2c14 {
	clock-frequency = <100000>;
	status = "okay";
};
